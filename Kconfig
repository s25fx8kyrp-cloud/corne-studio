## config/west.yml
```yaml
manifest:
  remotes:
    - name: zmkfirmware
      url-base: https://github.com/zmkfirmware
  projects:
    - name: zmk
      remote: zmkfirmware
      revision: 0331b7d16e80954b807917f9323e59ffc1e3b626
      import: app/west.yml
  self:
    path: config
```
